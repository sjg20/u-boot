// SPDX-License-Identifier: GPL-2.0+

/dts-v1/;

/ {
	#address-cells = <1>;
	#size-cells = <1>;

	binman {
		capsule {
			type = "efi-capsule";
			image-index = <0x1>;
			hardware-instance = <0x0>;
			capsule = "test.capsule";

			blob-ext {
				filename = "efi_capsule_payload.bin";
			};
		};
	};
};
