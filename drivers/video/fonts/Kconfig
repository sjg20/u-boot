## drivers/video/fonts/Kconfig
```kconfig
#
# Video fonts
#

menu "TrueType Fonts"

config CONSOLE_TRUETYPE_ROBOTO
	bool "Roboto Regular"
	depends on CONSOLE_TRUETYPE
	default y
	help
	  Roboto was created in 2011 by Christian Robertson at Google, and
	  received a significant redesign in 2014. It is a sans-serif grotesque,
	  which is the same classification as Helvetica and Akzidenz-Grotesk.
	  Roboto is the default font on the Android mobile phone operating
	  system.
	  From: https://fontlibrary.org/en/font/roboto
	  License: Apache 2.0
	  https://www.apache.org/licenses/LICENSE-2.0

config CONSOLE_TRUETYPE_ANKACODER
	bool "Anka Coder Narrow"
	depends on CONSOLE_TRUETYPE
	help
	  The Anka/Coder family is a monospaced, courier-width font for source
	  code and terminals, in two styles and weights. Anka/Coder Narrow was
	  developed for printing source code.
	  https://code.google.com/p/anka-coder-fonts/
	  From: https://fontlibrary.org/en/font/anka-coder-narrow
	  License: SIL Open Font Licence
	  http://scripts.sil.org/cms/scripts/page.php?site_id=nrsi&id=OFL

config CONSOLE_TRUETYPE_RUFSCRIPT
	bool "Ruf Script"
	depends on CONSOLE_TRUETYPE
	help
	  A laid-back handwritten font.
	  Font: https://fontlibrary.org/en/font/rufscript
	  License: GPL with font exception
	  http://www.gnu.org/copyleft/gpl.html

config CONSOLE_TRUETYPE_CANTORAONE
	bool "Cantoraone"
	depends on CONSOLE_TRUETYPE
	help
	  Cantora is a friendly semi formal, semi condensed, semi sans-serif
	  with a hint of handwriting. Perfect for headlines.
	  From https://fontlibrary.org/en/font/cantora
	  License: SIL Open Font Licence
	  http://scripts.sil.org/cms/scripts/page.php?site_id=nrsi&id=OFL

endmenu
```

## fs/fat/Kconfig
```kconfig
config FS_FAT
	bool "Enable FAT filesystem support"
	help
	  This provides support for reading images from File Allocation Table
	  (FAT) filesystem. FAT filesystem is a legacy, lightweight filesystem.
	  It is useful mainly for its wide compatibility with various operating
	  systems. You can also enable CMD_FAT to get access to fat commands.

config FAT_WRITE
	bool "Enable FAT filesystem write support"
	depends on FS_FAT
	help
	  This provides support for creating and writing new files to an
	  existing FAT filesystem partition.

config FS_FAT_MAX_CLUSTSIZE
	int "Set maximum possible clustersize"
	default 65536
	depends on FS_FAT
	help
	  Set the maximum possible clustersize for the FAT filesytem. This
	  is the smallest amount of disk space that can be used to hold a
	  file. Unless you have an extremely tight memory memory constraints,
	  leave the default.

config FAT_BLK_XLATE
	bool "Enable FAT filesystem on a device with a larger block size"
	depends on FS_FAT
	help
	  This provides a simple translation mechanism for reading FAT
	  filesystems which don't use the same sector size as the underlying
	  media. For example, the FAT filesystem may use 512 bytes but the
	  media uses 2048, e.g. on a CDROM drive.

	  This only supports the case where the FAT filesystem's sector size is
	  smaller than the media's block size. It does not support creating or
	  writing files.
```

## test/lib/Kconfig
```kconfig
# SPDX-License-Identifier: GPL-2.0+
# Copyright 2022 Google LLC

if SANDBOX

config TEST_KCONFIG
	bool "Enable detection of Kconfig macro errors"
	help
	  This is used to test that the IF_ENABLED_INT() macro causes a build error
	  if the value is used when the CONFIG Is not enabled.

config TEST_KCONFIG_ENABLE
	bool "Option to enable"
	help
	  This is the option that controls whether the value is present.

config TEST_KCONFIG_VALUE
	int "Value associated with the option"
	depends on TEST_KCONFIG_ENABLE
	help
	  This is the value which is present if TEST_KCONFIG_ENABLE is enabled.

config SPL_TEST_KCONFIG
	bool "Enable detection of Kconfig macro errors (SPL)"
	help
	  This is used to test that the IF_ENABLED_INT() macro causes a build error
	  if the value is used when the CONFIG Is not enabled.

config SPL_TEST_KCONFIG_ENABLE
	bool "Option to enable (SPL)"
	help
	  This is the option that controls whether the value is present.

config SPL_TEST_KCONFIG_VALUE
	int "Value associated with the option (SPL"
	depends on SPL_TEST_KCONFIG_ENABLE
	help
	  This is the value which is present if SPL_TEST_KCONFIG_ENABLE is
	  enabled.

endif # SANDBOX
```

## try.its
```
/dts-v1/;

/ {
    description = "Linux with devicetree set";
    #address-cells = <0x00000001>;
    timestamp = <0x6547ba1d>;
    images {
        kernel {
            description = "Linux";
            type = "kernel_noload";
            arch = "arm64";
            os = "linux";
            compression = "none";
            load = <0x00000000>;
            entry = <0x00000000>;
/*            data = /incbin/("/tmp/casper/vmlinuz"); */
/*            data = /incbin/("/tmp/casper/asc"); */
            data = /incbin/("/tmp/kern/arch/arm64/boot/Image");
            rand-seed {
                compatible = "vbe,rand-seed";
                rand-seed-size = <0x00000020>;
            };
            tcg2-log {
                compatible = "vbe,tcg2-log";
            };
            kaslr-rand {
                compatible = "vbe,kaslr-rand";
                rand-seed-size = <0x00000004>;
            };
        };
        initrd {
            description = "Linux";
            type = "ramdisk";
            arch = "arm64";
            os = "linux";
            compression = "none";
            data = /incbin/("/tmp/casper/initrd.raw");
        };
    };
    configurations {
        default = "conf-1";
        conf-1 {
            description = "Linux";
            kernel = "kernel";
            ramdisk = "initrd";
        };
    };
};
```
