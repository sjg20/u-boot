## arch/sandbox/Kconfig
```kconfig
menu "Sandbox architecture"
	depends on SANDBOX

config SYS_ARCH
	default "sandbox"

config SYS_BOARD
	default "sandbox"

config SYS_CPU
	default "sandbox"

config SANDBOX64
	bool "Use 64-bit addresses"
	select PHYS_64BIT
	select HOST_64BIT

config SANDBOX_RAM_SIZE_MB
	int "RAM size in MiB"
	default 128
	range 64 4095 if !SANDBOX64
	range 64 268435456 if SANDBOX64
	help
	  Memory size of the sandbox in MiB. The default value is 128 MiB.
	  The minimum value is 64 MiB. The maximum value is 4095 MiB for the
	  32bit sandbox.

config SANDBOX_SPL
	bool "Enable SPL for sandbox"
	select SUPPORT_SPL

config SYS_CONFIG_NAME
	default "sandbox_spl" if SANDBOX_SPL
	default "sandbox" if !SANDBOX_SPL

choice
	prompt "Run sandbox on 32/64-bit host"
	default HOST_DETECT_BIT
	help
	  Sandbox can be built on 32-bit and 64-bit hosts. This is generally
	  auto-detected but you can force a particular word size here. If you
	  see strange warnings about SANDBOX_BITS_PER_LONG then you may have
	  selected the wrong value.

config HOST_32BIT
	bool "32-bit host"
	depends on !PHYS_64BIT

config HOST_64BIT
	bool "64-bit host"

config HOST_DETECT_BIT
	bool "Auto-detect bit size"

endchoice

config SANDBOX_CRASH_RESET
	bool "Reset on crash"
	help
	  If an illegal instruction or an illegal memory access occurs, the
	  sandbox by default writes a crash dump and exits. If you set this
	  flag, the sandbox is reset instead. This may be useful when running
	  test suites like the UEFI self certification test which continue
	  with the next test after a crash.

config SANDBOX_BITS_PER_LONG
	int
	default 32 if HOST_32BIT
	default 64 if HOST_64BIT

endmenu
```

## arch/x86/cpu/Kconfig
```kconfig
# SPDX-License-Identifier: GPL-2.0+

# platform-specific options below
source "arch/x86/cpu/apollolake/Kconfig"
source "arch/x86/cpu/baytrail/Kconfig"
source "arch/x86/cpu/braswell/Kconfig"
source "arch/x86/cpu/broadwell/Kconfig"
source "arch/x86/cpu/coreboot/Kconfig"
source "arch/x86/cpu/efi/Kconfig"
source "arch/x86/cpu/ivybridge/Kconfig"
source "arch/x86/cpu/qemu/Kconfig"
source "arch/x86/cpu/quark/Kconfig"
source "arch/x86/cpu/queensbay/Kconfig"
source "arch/x86/cpu/slimbootloader/Kconfig"
source "arch/x86/cpu/tangier/Kconfig"
source "arch/x86/cpu/tigerlake/Kconfig"

source "arch/x86/cpu/intel_common/Kconfig"
```

## arch/x86/cpu/apollolake/Kconfig
```kconfig
# SPDX-License-Identifier: GPL-2.0
#
# Copyright 2019 Google LLC
#

config INTEL_APOLLOLAKE
	bool
	select FSP_VERSION2
	select HAVE_FSP
	select ARCH_MISC_INIT
	select USE_CAR
	select INTEL_PMC
	select TPL_X86_TSC_TIMER_NATIVE
	select SPL_PCH_SUPPORT
	select TPL_PCH_SUPPORT
	select PCH_SUPPORT
	select P2SB
	imply ENABLE_MRC_CACHE
	imply AHCI_PCI
	imply SCSI
	imply SCSI_AHCI
	imply SPI_FLASH
	imply USB
	imply USB_EHCI_HCD
	imply TPL
	imply SPL
	imply TPL_X86_16BIT_INIT
	imply TPL_OF_PLATDATA
	imply ITSS
	imply POWER_MGR

if INTEL_APOLLOLAKE

config DCACHE_RAM_BASE
	default 0xfef00000

config DCACHE_RAM_SIZE
	default 0xc0000

config DCACHE_RAM_MRC_VAR_SIZE
	default 0xb0000

config CPU_SPECIFIC_OPTIONS
	def_bool y
	select SMM_TSEG
	select X86_RAMTEST

config SMM_TSEG_SIZE
	hex
	default 0x800000

config MMCONF_BASE_ADDRESS
	hex
	default 0xe0000000

config INTEL_GPIO_DUAL_ROUTE_SUPPORT
	def_bool y

config INTEL_GPIO_PADCFG_PADTOL
	def_bool n

config INTEL_GPIO_IOSTANDBY
	def_bool y

config TPL_SIZE_LIMIT
	default 0x7800

endif
```

## arch/x86/cpu/intel_common/Kconfig
```kconfig
# SPDX-License-Identifier: GPL-2.0+

config INTEL_SOC
	bool
	help
	  This is enabled on Intel SoCs that can support various advanced
	  features such as power management (requiring asm/arch/pm.h), system
	  agent (asm/arch/systemagent.h) and an I/O map for ACPI
	  (asm/arch/iomap.h).

	  This cannot be selected in a defconfig file. It must be enabled by a
	  'select' in the SoC's Kconfig.

if INTEL_SOC

config INTEL_ACPIGEN
	bool "Support ACPI table generation for Intel SoCs"
	depends on ACPIGEN
	help
	  This option adds some functions used for programmatic generation of
	  ACPI tables on Intel SoCs. This provides features for writing CPU
	  information such as P states and T stages. Also included is a way
	  to create a GNVS table and set it up.

config INTEL_GMA_ACPI
	bool "Generate ACPI table for Intel GMA graphics"
	help
	  The Intel GMA graphics driver in Linux expects an ACPI table
	  which describes the layout of the registers and the display
	  connected to the device. Enable this option to create this
	  table so that graphics works correctly.

config INTEL_GENERIC_WIFI
	bool "Enable generation of ACPI tables for Intel WiFi"
	help
	  Select this option to provide code to a build generic WiFi ACPI table
	  for Intel WiFi devices. This is not a WiFi driver and offers no
	  network functionality. It is only here to generate the ACPI tables
	  required by Linux.

config INTEL_GMA_SWSMISCI
	bool
	help
	  Select this option for Atom-based platforms which use the SWSMISCI
	  register (0xe0) rather than the SWSCI register (0xe8).

config HAVE_ITSS
	bool "Enable ITSS"
	help
	  Select this to include the driver for the Interrupt Timer
	  Subsystem (ITSS) which is found on several Intel devices.

config HAVE_P2SB
	bool "Enable P2SB"
	depends on P2SB
	help
	  Select this to include the driver for the Primary to
	  Sideband Bridge (P2SB) which is found on several Intel
	  devices.

config INTEL_CAR_CQOS
	bool "Support Intel Cache Quality of Service"
	help
	  Cache Quality of Service allows more fine-grained control of cache
	  usage. As result, it is possible to set up a portion of L2 cache for
	  CAR and use the remainder for actual caching.

#
# Each bit in QOS mask controls this many bytes. This is calculated as:
# (CACHE_WAYS / CACHE_BITS_PER_MASK) * CACHE_LINE_SIZE * CACHE_SETS
#
config CACHE_QOS_SIZE_PER_BIT
	hex
	depends on INTEL_APOLLOLAKE && INTEL_CAR_CQOS
	default 0x20000 # 128 KB

config INTEL_CAR_NEM_ENHANCED
	bool
	help
	  A current limitation of NEM (Non-Evict mode) is that code and data sizes
	  are derived from the requirement to not write out any modified cache line.
	  With NEM, if there is no physical memory behind the cached area,
	  the modified data will be lost and NEM results will be inconsistent.
	  ENHANCED NEM guarantees that modified data is always
	  kept in cache while clean data is replaced.

config CAR_HAS_SF_MASKS
	bool
	depends on INTEL_CAR_NEM_ENHANCED
	help
	  In the case of non-inclusive cache architecture Snoop Filter MSR
	  IA32_L3_SF_MASK_x programming is required along with the data ways.
	  This is applicable for TGL and beyond.

config SF_MASK_2WAYS_PER_BIT
	bool
	depends on INTEL_CAR_NEM_ENHANCED
	help
	  In the case of non-inclusive cache architecture when two ways in
	  the SF mask are controlled by one bit of the SF QoS register.
	  This is applicable for TGL alone.

config COS_MAPPED_TO_MSB
	bool
	depends on INTEL_CAR_NEM_ENHANCED
	help
	  On TGL and JSL platform the class of service configuration
	  is mapped to MSB of MSR IA32_PQR_ASSOC.

endif # INTEL_SOC
```

## board/designa/snappermx6/Kconfig
```kconfig
if TARGET_SNAPPERMX6

config SYS_BOARD
	default "snappermx6"

config SYS_VENDOR
	default "designa"

config SYS_CONFIG_NAME
	default "snappermx6"

endif
```

## board/efi/Kconfig
```kconfig
if VENDOR_EFI

choice
	prompt "Mainboard model"
	optional

config TARGET_EFI_APP32
	bool "32-bit efi application"
	select EFI_APP
	help
	  This target is used for running U-Boot on top of EFI. In
	  this case EFI does the early initialisation, and U-Boot
	  takes over once the RAM, video and CPU are fully running.
	  U-Boot is loaded as an application from EFI.

config TARGET_EFI_APP64
	bool "64-bit efi application"
	select EFI_APP
	help
	  This target is used for running U-Boot on top of EFI in 64-bit mode.
	  In this case EFI does the early initialisation, and U-Boot
	  takes over once the RAM, video and CPU are fully running.
	  U-Boot is loaded as an application from EFI.

config TARGET_EFI_PAYLOAD
	bool "efi payload"
	select EFI_PAYLOAD
	help
	  This target is used for running U-Boot on top of EFI. In
	  this case EFI does the early initialisation, and U-Boot
	  takes over once the RAM, video and CPU are fully running.
	  U-Boot is loaded as a payload from EFI.

config TARGET_CHROMEOS_EFI_PAYLOAD
	bool "efi payload"
	select EFI_PAYLOAD
	help
	  This is the Chromium OS version of TARGET_EFI_PAYLOAD, allowing
	  Chromium OS to boot on top of EFI.

	  In this case EFI does the early initialisation, and U-Boot
	  takes over once the RAM, video and CPU are fully running.
	  U-Boot is loaded as a payload from EFI.

config TARGET_CHROMEOS_EFI_APP32
	bool "efi payload"
	select EFI_APP
	help
	  This is the Chromium OS version of TARGET_EFI_APP32, allowing
	  Chromium OS to boot on top of EFI.

	  In this case EFI does the early initialisation, and U-Boot
	  takes over once the RAM, video and CPU are fully running.
	  U-Boot is loaded as an app from EFI.

endchoice

source "board/efi/efi-x86_app/Kconfig"
source "board/efi/efi-x86_payload/Kconfig"

endif
```

## board/efi/efi-x86_app/Kconfig
```kconfig
if EFI_APP

config SYS_BOARD
	default "efi-x86_app"

config SYS_VENDOR
	default "efi"

config SYS_SOC
	default "efi"

config SYS_CONFIG_NAME
	default "efi-x86_app" if !TARGET_CHROMEOS_EFI_APP32

config BOARD_SPECIFIC_OPTIONS # dummy
	def_bool y
	imply VIDEO_EFI

endif

if TARGET_CHROMEOS_EFI_APP32

config SYS_CONFIG_NAME
	default "chromeos_efi-x86_app"

endif
```

## board/efi/efi-x86_payload/Kconfig
```kconfig
config EFI_PAYLOAD
	bool
	help
	  U-Boot starts as a payload of EFI. EFI does the early initialisation
	  and U-Boot takes over once the RAM, video and CPU are fully running.
	  U-Boot is loaded as a payload from EFI.

if EFI_PAYLOAD

config SYS_BOARD
	default "efi-x86_payload"

config SYS_VENDOR
	default "efi"

config SYS_SOC
	default "efi"

config SYS_TEXT_BASE
	default 0x00200000

config BOARD_SPECIFIC_OPTIONS # dummy
	def_bool y
	select BOARD_EARLY_INIT_R
	imply SYS_NS16550
	imply SCSI
	imply SCSI_AHCI
	imply AHCI_PCI
	imply MMC
	imply MMC_PCI
	imply MMC_SDHCI
	imply MMC_SDHCI_SDMA
	imply USB
	imply USB_EHCI_HCD
	imply USB_XHCI_HCD
	imply USB_STORAGE
	imply USB_KEYBOARD
	imply VIDEO_EFI
	imply E1000
	imply ETH_DESIGNWARE
	imply PCH_GBE
	imply RTL8169

endif

if TARGET_EFI_PAYLOAD

config SYS_CONFIG_NAME
	default "efi-x86_payload"

endif

if TARGET_CHROMEOS_EFI_PAYLOAD

config SYS_CONFIG_NAME
	default "chromeos_efi-x86_payload"

endif
```

## board/emulation/qemu-arm/Kconfig
```kconfig
if ARCH_QEMU

config BOARD_SPECIFIC_OPTIONS # dummy
	def_bool y
	select CMD_QFW
	select QFW_MMIO
	select SUPPORT_SPL
	imply VIRTIO_MMIO
	imply VIRTIO_PCI
	imply VIRTIO_NET
	imply VIRTIO_BLK

endif

if TARGET_QEMU_ARM_32BIT || TARGET_QEMU_ARM_64BIT

config SYS_TEXT_BASE
	default 0x00000000

endif

if TARGET_QEMU_ARM_64BIT && !TFABOOT
config BOARD_SPECIFIC_OPTIONS
	imply SYS_MTDPARTS_RUNTIME
	imply SET_DFU_ALT_INFO

source "board/emulation/common/Kconfig"
endif

if TARGET_QEMU_ARM_32BIT_SPL

config SPL_TEXT_BASE
	default 0x00000000

config SYS_TEXT_BASE
	default 0x00010000

endif
```

## board/sandbox/Kconfig
```kconfig
if TARGET_SANDBOX || TARGET_SANDBOX_FLATTREE || TARGET_SANDBOX64

config SYS_CONFIG_NAME
	default "sandbox"

endif

if TARGET_SANDBOX_SPL

config SYS_CONFIG_NAME
	default "sandbox_spl"

endif

if TARGET_CHROMEOS_SANDBOX

config SYS_CONFIG_NAME
	default "chromeos_sandbox"

endif
```

## common/feature/Kconfig
```kconfig
config FEATURE
	bool "Support U-Boot features"
	help
	  Features are simple GUI applications provided in U-Boot, such as a
	  boot menu or firmware-based diagnostics. Features are provided as
	  drivers in the 'feature' uclass.
```

## configs/chromebook_coral_defconfig
```kconfig
CONFIG_X86=y
CONFIG_SYS_TEXT_BASE=0x1110000
CONFIG_SYS_MALLOC_F_LEN=0x1d00
CONFIG_SPL_SYS_MALLOC_F_LEN=0xd000
CONFIG_NR_DRAM_BANKS=8
CONFIG_DEBUG_UART_BOARD_INIT=y
CONFIG_DEBUG_UART_BASE=0xde000000
CONFIG_DEBUG_UART_CLOCK=1843200
CONFIG_VENDOR_GOOGLE=y
CONFIG_TARGET_CHROMEBOOK_CORAL=y
CONFIG_DEBUG_UART=y
CONFIG_FSP_VERSION2=y
CONFIG_HAVE_ACPI_RESUME=y
CONFIG_INTEL_CAR_CQOS=y
CONFIG_X86_OFFSET_U_BOOT=0xffe00000
CONFIG_X86_OFFSET_SPL=0xffe80000
CONFIG_SPL_TEXT_BASE=0xfef10000
CONFIG_BOOTSTAGE=y
CONFIG_BOOTSTAGE_REPORT=y
CONFIG_USE_BOOTARGS=y
CONFIG_BOOTARGS="root=/dev/sdb3 init=/sbin/init rootwait ro"
CONFIG_SYS_CONSOLE_INFO_QUIET=y
CONFIG_SPL_LOG=y
CONFIG_LOG_DEFAULT_LEVEL=7
CONFIG_DISPLAY_BOARDINFO_LATE=y
CONFIG_LAST_STAGE_INIT=y
CONFIG_BLOBLIST=y
# CONFIG_TPL_BLOBLIST is not set
CONFIG_BLOBLIST_ADDR=0x100000
CONFIG_HANDOFF=y
CONFIG_TPL_SYS_MALLOC_SIMPLE=y
CONFIG_SPL_SEPARATE_BSS=y
CONFIG_SPL_CPU_SUPPORT=y
CONFIG_SPL_NET_SUPPORT=y
CONFIG_SPL_PCI=y
# CONFIG_TPL_SPI_SUPPORT is not set
CONFIG_HUSH_PARSER=y
CONFIG_CMD_CPU=y
CONFIG_CMD_PMC=y
# CONFIG_CMD_FLASH is not set
CONFIG_CMD_GPIO=y
CONFIG_CMD_I2C=y
CONFIG_CMD_PART=y
CONFIG_CMD_SATA=y
CONFIG_CMD_SPI=y
CONFIG_CMD_USB=y
# CONFIG_CMD_SETEXPR is not set
CONFIG_CMD_TIME=y
CONFIG_CMD_SOUND=y
CONFIG_CMD_BOOTSTAGE=y
CONFIG_CMD_TPM=y
CONFIG_CMD_TPM_TEST=y
CONFIG_CMD_EXT2=y
CONFIG_CMD_EXT4=y
CONFIG_CMD_EXT4_WRITE=y
CONFIG_CMD_FAT=y
CONFIG_CMD_FS_GENERIC=y
CONFIG_MAC_PARTITION=y
# CONFIG_SPL_MAC_PARTITION is not set
# CONFIG_SPL_DOS_PARTITION is not set
CONFIG_ISO_PARTITION=y
CONFIG_EFI_PARTITION=y
# CONFIG_SPL_EFI_PARTITION is not set
CONFIG_DEFAULT_DEVICE_TREE="chromebook_coral"
# CONFIG_NET is not set
CONFIG_REGMAP=y
CONFIG_SYSCON=y
CONFIG_SPL_OF_TRANSLATE=y
CONFIG_CPU=y
CONFIG_DM_I2C=y
CONFIG_SYS_I2C_DW=y
CONFIG_TPL_MISC=y
CONFIG_CROS_EC=y
CONFIG_CROS_EC_LPC=y
# CONFIG_SPI_FLASH is not set
CONFIG_SPI_FLASH_INTEL_FAST=y
# CONFIG_X86_PCH7 is not set
# CONFIG_X86_PCH9 is not set
CONFIG_DEBUG_UART_SHIFT=2
CONFIG_SYS_NS16550=y
CONFIG_SOUND=y
CONFIG_SOUND_I8254=y
CONFIG_SOUND_RT5677=y
CONFIG_SPI=y
CONFIG_TPL_SYSRESET=y
CONFIG_TPM_TIS_LPC=y
CONFIG_USB_STORAGE=y
CONFIG_USB_KEYBOARD=y
# CONFIG_DM_VIDEO is not set
CONFIG_SPL_FS_CBFS=y
# CONFIG_SPL_USE_TINY_PRINTF is not set
CONFIG_TPL_USE_TINY_PRINTF=y
CONFIG_CMD_DHRYSTONE=y
CONFIG_TPM=y
# CONFIG_EFI_LOADER is not set
```

## configs/chromeos_coreboot_defconfig
```kconfig
CONFIG_X86=y
CONFIG_SYS_TEXT_BASE=0x1110000
CONFIG_NR_DRAM_BANKS=8
CONFIG_ENV_SIZE=0x1000
CONFIG_PRE_CON_BUF_ADDR=0x100000
CONFIG_DEFAULT_DEVICE_TREE="coreboot"
CONFIG_VENDOR_COREBOOT=y
CONFIG_TARGET_CHROMEOS_COREBOOT=y
CONFIG_FIT=y
CONFIG_FIT_SIGNATURE=y
CONFIG_CHROMEOS=y
CONFIG_CHROMEOS_VBOOT=y
CONFIG_SHOW_BOOT_PROGRESS=y
CONFIG_USE_BOOTARGS=y
CONFIG_BOOTARGS="root=/dev/sdb3 init=/sbin/init rootwait ro"
CONFIG_PRE_CONSOLE_BUFFER=y
CONFIG_SYS_CONSOLE_INFO_QUIET=y
CONFIG_DISPLAY_BOARDINFO_LATE=y
CONFIG_LAST_STAGE_INIT=y
CONFIG_BLOBLIST_ADDR=110000
CONFIG_HUSH_PARSER=y
CONFIG_CMD_IDE=y
CONFIG_CMD_MMC=y
CONFIG_CMD_PART=y
CONFIG_CMD_USB=y
# CONFIG_CMD_SETEXPR is not set
CONFIG_CMD_DHCP=y
# CONFIG_CMD_NFS is not set
CONFIG_CMD_PING=y
CONFIG_CMD_TIME=y
CONFIG_CMD_SOUND=y
CONFIG_CMD_EXT2=y
CONFIG_CMD_EXT4=y
CONFIG_CMD_EXT4_WRITE=y
CONFIG_CMD_FAT=y
CONFIG_CMD_FS_GENERIC=y
CONFIG_MAC_PARTITION=y
CONFIG_ISO_PARTITION=y
CONFIG_EFI_PARTITION=y
CONFIG_ENV_OVERWRITE=y
CONFIG_SYS_RELOC_GD_ENV_ADDR=y
CONFIG_REGMAP=y
CONFIG_SYSCON=y
# CONFIG_PCI_PNP is not set
CONFIG_SOUND=y
CONFIG_SOUND_I8254=y
CONFIG_CONSOLE_SCROLL_LINES=5
# CONFIG_GZIP is not set
CONFIG_SMBIOS_PARSER=y
CONFIG_CMD_DHRYSTONE=y
CONFIG_LOG=y
CONFIG_I2C=y
CONFIG_DM_I2C=y
CONFIG_TPM2_CR50_I2C=y
CONFIG_SYS_I2C_DW=y
CONFIG_SPI_FLASH_WINBOND=y
CONFIG_ICH_SPI=y
#CONFIG_X86_PCH9=y
#CONFIG_INTEL_GPIO=y
CONFIG_CHROMEOS_COREBOOT=y
CONFIG_CROS_EC_LPC=y
CONFIG_LZMA=y
```
