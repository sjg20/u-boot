## configs/chromeos_efi-x86_app32_defconfig
```kconfig
CONFIG_X86=y
CONFIG_NR_DRAM_BANKS=8
CONFIG_ENV_SIZE=0x1000
CONFIG_DEFAULT_DEVICE_TREE="efi-x86_app"
CONFIG_DEBUG_UART_BASE=0
CONFIG_DEBUG_UART_CLOCK=0
CONFIG_VENDOR_EFI=y
CONFIG_TARGET_CHROMEOS_EFI_APP32=y
CONFIG_DEBUG_UART=y
CONFIG_FIT=y
CONFIG_SHOW_BOOT_PROGRESS=y
CONFIG_USE_BOOTARGS=y
CONFIG_BOOTARGS="root=/dev/sdb3 init=/sbin/init rootwait ro"
CONFIG_SYS_CONSOLE_INFO_QUIET=y
CONFIG_DISPLAY_BOARDINFO_LATE=y
CONFIG_LAST_STAGE_INIT=y
CONFIG_HUSH_PARSER=y
# CONFIG_CMD_BOOTM is not set
CONFIG_CMD_PART=y
# CONFIG_CMD_NET is not set
CONFIG_CMD_TIME=y
CONFIG_CMD_EXT2=y
CONFIG_CMD_EXT4=y
CONFIG_CMD_EXT4_WRITE=y
CONFIG_CMD_FAT=y
CONFIG_CMD_FS_GENERIC=y
CONFIG_MAC_PARTITION=y
CONFIG_ISO_PARTITION=y
CONFIG_EFI_PARTITION=y
CONFIG_OF_EMBED=y
CONFIG_ENV_OVERWRITE=y
CONFIG_SYS_RELOC_GD_ENV_ADDR=y
CONFIG_REGMAP=y
CONFIG_SYSCON=y
# CONFIG_REGEX is not set
# CONFIG_GZIP is not set
CONFIG_EFI=y
# CONFIG_EFI_LOADER is not set
CONFIG_SYS_MALLOC_F_LEN=0x800
CONFIG_CHROMEOS=y
CONFIG_CHROMEOS_VBOOT=y
CONFIG_BLOBLIST_ADDR=0x100000
CONFIG_LOG_ERROR_RETURN=y
# CONFIG_CMD_SF_TEST is not set
CONFIG_DM_ETH=y
CONFIG_LOGF_FUNC=y
CONFIG_BLOBLIST_SIZE=0x18000
CONFIG_BLOBLIST_SIZE_RELOC=0x18000
CONFIG_FWSTORE_FS=y
# CONFIG_CROS_EC is not set
CONFIG_NVDATA_FS=y
CONFIG_FAT_WRITE=y
```

## configs/crownbay_defconfig
```kconfig
CONFIG_X86=y
CONFIG_VENDOR_INTEL=y
CONFIG_DEFAULT_DEVICE_TREE="crownbay"
CONFIG_TARGET_CROWNBAY=y
CONFIG_SMP=y
CONFIG_MAX_CPUS=2
CONFIG_GENERATE_PIRQ_TABLE=y
CONFIG_CMD_CPU=y
CONFIG_CMD_NET=y
CONFIG_OF_CONTROL=y
CONFIG_CPU=y
```

## configs/efi-arm_app64_defconfig
```kconfig
CONFIG_ARM=y
# CONFIG_ARM64_CRC32 is not set
CONFIG_ARCH_EFI_ARM=y
CONFIG_NR_DRAM_BANKS=8
CONFIG_ENV_SIZE=0x1000
CONFIG_DEFAULT_DEVICE_TREE="efi-arm_app"
CONFIG_DEBUG_UART_BASE=0x0
CONFIG_DEBUG_UART_CLOCK=0
CONFIG_DEBUG_UART=y
CONFIG_TARGET_EFI_ARM_APP64=y
CONFIG_EFI_CLIENT=y
CONFIG_EFI_APP_64BIT=y
CONFIG_EFI_RAM_SIZE=0x20000000
CONFIG_FIT=y
CONFIG_BOOTSTD_FULL=y
CONFIG_SHOW_BOOT_PROGRESS=y
CONFIG_OF_SYSTEM_SETUP=y
CONFIG_FDT_SIMPLEFB=y
CONFIG_USE_BOOTARGS=y
CONFIG_BOOTCOMMAND="bootflow scan -lbp"
CONFIG_SYS_PBSIZE=532
CONFIG_SYS_CONSOLE_INFO_QUIET=y
CONFIG_LOG=y
CONFIG_LOGF_FUNC=y
CONFIG_DISPLAY_BOARDINFO_LATE=y
CONFIG_CYCLIC_MAX_CPU_TIME_US=50000
CONFIG_BOARD_EARLY_INIT_R=y
CONFIG_CMD_SMBIOS=y
CONFIG_CMD_BOOTZ=y
CONFIG_CMD_MEMINFO=y
CONFIG_CMD_MEMINFO_MAP=y
CONFIG_CMD_DM=y
CONFIG_CMD_LSBLK=y
CONFIG_CMD_CAT=y
CONFIG_CMD_CACHE=y
CONFIG_CMD_TIME=y
CONFIG_CMD_KASLRSEED=y
CONFIG_CMD_HASH=y
CONFIG_CMD_EXT4_WRITE=y
CONFIG_MAC_PARTITION=y
CONFIG_OF_LIVE=y
CONFIG_ENV_OVERWRITE=y
CONFIG_SYS_RELOC_GD_ENV_ADDR=y
CONFIG_USE_BOOTFILE=y
CONFIG_BOOTFILE="bzImage"
CONFIG_NO_NET=y
CONFIG_REGMAP=y
CONFIG_SYSCON=y
CONFIG_DM_RNG=y
CONFIG_SYSRESET=y
CONFIG_VIDEO=y
CONFIG_CONSOLE_TRUETYPE=y
CONFIG_SYS_WHITE_ON_BLACK=y
CONFIG_CONSOLE_SCROLL_LINES=5
CONFIG_FAT_WRITE=y
CONFIG_ULIB=y
CONFIG_EXAMPLES=y
CONFIG_RUST_EXAMPLES=y
CONFIG_CMD_DHRYSTONE=y
```

## configs/efi-riscv_app64_defconfig
```kconfig
CONFIG_RISCV=y
CONFIG_NR_DRAM_BANKS=8
CONFIG_ENV_SIZE=0x1000
CONFIG_DEFAULT_DEVICE_TREE="efi-riscv_app"
CONFIG_DEBUG_UART_BASE=0x0
CONFIG_DEBUG_UART_CLOCK=0
CONFIG_ARCH_EFI_RISCV=y
CONFIG_ARCH_RV64I=y
CONFIG_RISCV_SMODE=y
CONFIG_TARGET_EFI_RISCV_APP64=y
CONFIG_EFI_CLIENT=y
CONFIG_EFI_APP_64BIT=y
CONFIG_EFI_RAM_SIZE=0x20000000
CONFIG_FIT=y
CONFIG_BOOTSTD_FULL=y
CONFIG_SHOW_BOOT_PROGRESS=y
CONFIG_OF_SYSTEM_SETUP=y
CONFIG_FDT_SIMPLEFB=y
CONFIG_USE_BOOTARGS=y
CONFIG_BOOTCOMMAND="bootflow scan -lbp"
CONFIG_SYS_PBSIZE=532
CONFIG_SYS_CONSOLE_INFO_QUIET=y
CONFIG_LOG=y
CONFIG_LOGF_FUNC=y
CONFIG_DISPLAY_BOARDINFO_LATE=y
CONFIG_CYCLIC_MAX_CPU_TIME_US=50000
CONFIG_BOARD_EARLY_INIT_R=y
CONFIG_CMD_SMBIOS=y
CONFIG_CMD_MEMINFO=y
CONFIG_CMD_MEMINFO_MAP=y
CONFIG_CMD_LSBLK=y
CONFIG_CMD_CAT=y
CONFIG_CMD_CACHE=y
CONFIG_CMD_TIME=y
CONFIG_CMD_KASLRSEED=y
CONFIG_CMD_HASH=y
CONFIG_CMD_EXT4_WRITE=y
CONFIG_MAC_PARTITION=y
CONFIG_OF_LIVE=y
CONFIG_ENV_OVERWRITE=y
CONFIG_SYS_RELOC_GD_ENV_ADDR=y
CONFIG_USE_BOOTFILE=y
CONFIG_BOOTFILE="Image"
CONFIG_NO_NET=y
CONFIG_REGMAP=y
CONFIG_SYSCON=y
CONFIG_DM_RNG=y
CONFIG_DEBUG_EFI_CONSOLE=y
CONFIG_SYSRESET=y
CONFIG_VIDEO=y
CONFIG_CONSOLE_TRUETYPE=y
CONFIG_SYS_WHITE_ON_BLACK=y
CONFIG_CONSOLE_SCROLL_LINES=5
CONFIG_FAT_WRITE=y
CONFIG_ULIB=y
CONFIG_EXAMPLES=y
CONFIG_RUST_EXAMPLES=y
CONFIG_CMD_DHRYSTONE=y
```

## configs/efi-x86_app64_defconfig
```kconfig
CONFIG_X86=y
CONFIG_SYS_MALLOC_F_LEN=0x1000
CONFIG_NR_DRAM_BANKS=8
CONFIG_ENV_SIZE=0x1000
CONFIG_DEFAULT_DEVICE_TREE="efi-x86_app"
CONFIG_DEBUG_UART_BASE=0x0
CONFIG_DEBUG_UART_CLOCK=0
CONFIG_X86_RUN_64BIT=y
CONFIG_ARCH_EFI_X86=y
CONFIG_DEBUG_UART=y
# CONFIG_AHCI is not set
CONFIG_TARGET_EFI_X86_APP64=y
CONFIG_EFI_CLIENT=y
CONFIG_EFI_APP_64BIT=y
CONFIG_FIT=y
CONFIG_BOOTSTD_FULL=y
CONFIG_SHOW_BOOT_PROGRESS=y
CONFIG_USE_BOOTARGS=y
CONFIG_BOOTARGS="root=/dev/sdb3 init=/sbin/init rootwait ro"
CONFIG_SYS_PBSIZE=532
CONFIG_SYS_CONSOLE_INFO_QUIET=y
# CONFIG_CONSOLE_PAGER is not set
CONFIG_LOG=y
CONFIG_BOARD_EARLY_INIT_R=y
CONFIG_BLOBLIST=y
CONFIG_CMD_LSBLK=y
CONFIG_CMD_CAT=y
CONFIG_CMD_TIME=y
CONFIG_CMD_EXT4_WRITE=y
CONFIG_MAC_PARTITION=y
CONFIG_ENV_OVERWRITE=y
CONFIG_ENV_IS_IN_FAT=y
CONFIG_ENV_FAT_INTERFACE="efi"
CONFIG_ENV_FAT_DEVICE_AND_PART="0:0"
CONFIG_SYS_RELOC_GD_ENV_ADDR=y
CONFIG_USE_BOOTFILE=y
CONFIG_BOOTFILE="bzImage"
CONFIG_NO_NET=y
CONFIG_REGMAP=y
CONFIG_SYSCON=y
# CONFIG_SCSI is not set
# CONFIG_TPM_V1 is not set
CONFIG_TPM2_EFI=y
CONFIG_VIDEO_COPY=y
CONFIG_CONSOLE_TRUETYPE=y
CONFIG_CONSOLE_TRUETYPE_UBUNTU_LIGHT=y
CONFIG_CONSOLE_TRUETYPE_UBUNTU_BOLD=y
CONFIG_CONSOLE_SCROLL_LINES=5
CONFIG_BMP_16BPP=y
CONFIG_BMP_24BPP=y
CONFIG_CMD_DHRYSTONE=y
CONFIG_TPM=y
CONFIG_ULIB=y
CONFIG_EXAMPLES=y
CONFIG_RUST_EXAMPLES=y
# CONFIG_GZIP is not set
```

## configs/rpi_defconfig
```kconfig
CONFIG_ARM=y
CONFIG_ARCH_BCM283X=y
CONFIG_TARGET_RPI=y
CONFIG_CMD_NET=y
CONFIG_OF_CONTROL=y
CONFIG_DEFAULT_DEVICE_TREE="bcm2835-rpi-b"
CONFIG_USB=y
CONFIG_DM_USB=y
CONFIG_DM_ETH=y
```

## configs/snappermx6_defconfig
```kconfig
CONFIG_ARM=y
CONFIG_ARCH_MX6=y
CONFIG_SYS_TEXT_BASE=0x17800000
CONFIG_SPL_GPIO_SUPPORT=y
CONFIG_SPL_LIBCOMMON_SUPPORT=y
CONFIG_SPL_LIBGENERIC_SUPPORT=y
CONFIG_MX6_DDRCAL=y
CONFIG_TARGET_SNAPPERMX6=y
CONFIG_SPL_SERIAL_SUPPORT=y
CONFIG_SPL_SPI_FLASH_SUPPORT=y
CONFIG_SPL_SPI_SUPPORT=y
CONFIG_ENV_SIZE=0x4000
CONFIG_ENV_OFFSET=0x60000
CONFIG_NR_DRAM_BANKS=1
CONFIG_SPL=y
CONFIG_SPL_LIBDISK_SUPPORT=y
CONFIG_SPL_TEXT_BASE=0x00908000
CONFIG_DISTRO_DEFAULTS=y
CONFIG_FIT=y
CONFIG_FIT_VERBOSE=y
CONFIG_BOOTDELAY=1
# CONFIG_USE_BOOTCOMMAND is not set
CONFIG_SILENT_CONSOLE=y
CONFIG_SILENT_U_BOOT_ONLY=y
CONFIG_VERSION_VARIABLE=y
CONFIG_BOUNCE_BUFFER=y
CONFIG_BOARD_EARLY_INIT_F=y
CONFIG_SPL_FS_EXT4=y
CONFIG_SPL_I2C_SUPPORT=y
CONFIG_SPL_WATCHDOG_SUPPORT=y
CONFIG_CMD_GPIO=y
CONFIG_CMD_CACHE=y
CONFIG_CMD_EXT4_WRITE=y
CONFIG_SYS_RELOC_GD_ENV_ADDR=y
CONFIG_DM=y
CONFIG_MTD=y
CONFIG_PHYLIB=y
CONFIG_PHY_FIXED=y
CONFIG_FEC_MXC=y
CONFIG_ETHPRIME="FEC"
CONFIG_FEC_MXC_PHYADDR=0
CONFIG_MII=y
CONFIG_DM_THERMAL=y
CONFIG_OF_LIBFDT=y
```

## cros/dts/bindings/vboot-flags.txt
```
Chromium OS Verified Boot Flags
===============================

The device tree nodes which describes the Chromium OS vboot flags are as
follows:


The node name is the name of the flag. Each flag returns a value of 0 (off) or
1 (on). Available flags are:

- write-protect: hardware write-protect signal from Cr50
- developer: developer mode signal, typically from TPM, but some other option
     has been used historically, such as a physical button
- lid-open: typically a GPIO
- power-button: state of the power button (1=pressed), typically a GPIO or a
     keyboard key
- ec-in-rw: EC is in read-write code, typically a GPIO
- oprom-loaded: Option ROM has been loaded, which indicates video is available
- recovery: Recovery mode is selected, typically read from the EC or a button

Multiple devices are supported for each flag, in which case they are considered
in devicetree order.

Common optional properties:

- primary-only: Indicates that the device should only be active if U-Boot is
  the primary bootloader. If U-Boot is booted from coreboot, this device is
  ignored, since it is not possible for U-Boot to read the signal reliably
  at the instant of boot and the signal may later change.


Constant
--------

This uses a constant flag, set at build time.

Required properties :
- compatible = "google,const-flag"
- value : Integer value of value (0 or 1)


GPIO
----

This reads the flag from a GPIO.

Required properties :
- compatible = "google,gpio-flag"
- gpio : phandle indicating the GPIO to use (including polarity)


Optional properties :
- sandbox-value : Value to set the GPIO to on initial startup (0 or 1). Only
     sandbox allows setting these values, since it has a emulated GPIO system.


Key
---

This reads the flag from the keyboard, useful for sandbox

Required properties :
- compatible = "google,key-flag"
- key : Key code number to use (#include <linux/input.h> to get these)


Sysinfo
-------

This reads the flag from coreboot tables.

Required properties :
- compatible = "google,sysinfo-flag"


EC
--

This reads the flag from the Chromium OS EC

Required properties :
- compatible = "google,cros-ec-flag"


Example
=======

	#include <linux/input.h>

	write-protect {
		compatible = "google,gpio-flag";
		gpio = <&gpio_a 1>;
	};
	developer {
		compatible = "google,const-flag";
		value = <1>;
	};
	lid-open {
		compatible = "google,sysinfo-flag";
		google,name = "lid";
	};
	power-button {
		compatible = "google,key-flag";
		key = <KEY_PAUSE>;
	};
	oprom-loaded {
		compatible = "google,const-flag";
		value = <0>;
	};
	ec-in-rw {
		compatible = "google,gpio-flag";
		gpio = <&gpio_a 3>;
	};
```

## cros/fwstore/Kconfig
```kconfig
# SPDX-License-Identifier: GPL-2.0+
#
# Copyright 2018 Google LLC
#

config FWSTORE_SPI_FLASH
	bool "Firmware storage driver that uses SPI flash"
	select SPI
	select DM_SPI
	select SPI_FLASH
	select DM_SPI_FLASH
	help
	  This provides a driver for firmware storage that uses SPI flash.
	  The device typically has a read-only portion (controlled by a write-
	  protect pin and block-protect pins in the SPI-flash status register)
	  and a read-write portion. The latter is used to store upgradeable
	  parts of the firmware.

config SPL_FWSTORE_SPI_FLASH
	bool "Firmware storage driver that uses SPI flash in SPL"
	select SPL_SPI_SUPPORT
	select SPL_DM_SPI
	select SPL_SPI_FLASH_SUPPORT
	select SPL_DM_SPI_FLASH
	help
	  This provides a driver for firmware storage that uses SPI flash.
	  The device typically has a read-only portion (controlled by a write-
	  protect pin and block-protect pins in the SPI-flash status register)
	  and a read-write portion. The latter is used to store upgradeable
	  parts of the firmware.

config TPL_FWSTORE_SPI_FLASH
	bool "Firmware storage driver that uses SPI flash in TPL"
	select TPL_SPI_SUPPORT
	select TPL_DM_SPI
	select TPL_SPI_FLASH_SUPPORT
	select TPL_DM_SPI_FLASH
	help
	  This provides a driver for firmware storage that uses SPI flash.
	  The device typically has a read-only portion (controlled by a write-
	  protect pin and block-protect pins in the SPI-flash status register)
	  and a read-write portion. The latter is used to store upgradeable
	  parts of the firmware.

config VPL_FWSTORE_SPI_FLASH
	bool "Firmware storage driver that uses SPI flash in VPL"
	select VPL_SPI_SUPPORT
	select VPL_DM_SPI
	select VPL_SPI_FLASH_SUPPORT
	select VPL_DM_SPI_FLASH
	help
	  This provides a driver for firmware storage that uses SPI flash.
	  The device typically has a read-only portion (controlled by a write-
	  protect pin and block-protect pins in the SPI-flash status register)
	  and a read-write portion. The latter is used to store upgradeable
	  parts of the firmware.

config FWSTORE_MMC
	bool "Firmware storage driver that uses MMC"
	help
	  This provides a driver for firmware storage that uses MMC. This is
	  an experimental feature which has not yet been shipped in a
	  Chromebook. The write-protection logic in MMC chips typically does
	  not provided an external hardware pin to control it, which makes it
	  hard to implement Chromium OS verified boot with MMC.
```

## doc/uImage.FIT/sign-fdt.its
```
g/dts-v1/;

/ {
    model = "Google Snow";
    chosen {
        bootargs = "console=tty1";
        stdout-path = "serial3:115200n8";
    };
    aliases {
        i2c0 = "/i2c@12C60000";
    };
};
```
