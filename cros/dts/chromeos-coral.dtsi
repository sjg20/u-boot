// SPDX-License-Identifier: GPL-2.0+
/*
 * Chromium OS-specific options for x86
 *
 * Copyright 2018 Google LLC
 */

#include <dt-bindings/gpio/gpio.h>
#include <dt-bindings/gpio/x86-gpio.h>
#include <asm/arch-apollolake/gpio.h>
#include <chromeos-x86.dtsi>
#include "chromeos-coreboot-flags.dtsi"

/ {
	chromeos_dev: chromeos {
		ec-in-rw {
			u-boot,dm-spl;
			u-boot,dm-vpl;
			compatible = "google,gpio-flag";
			gpio = <&gpio_n GPIO_41 GPIO_ACTIVE_HIGH>;
		};

		write-protect {
			u-boot,dm-spl;
			u-boot,dm-vpl;
			compatible = "google,gpio-flag";
			primary-only;
			gpio = <&gpio_nw GPIO_75 GPIO_ACTIVE_HIGH>;
		};
	};
};
